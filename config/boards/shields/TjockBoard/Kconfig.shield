## config/boards/shields/TjockBoard/Kconfig.shield
```kconfig
# Copyright (c) 2022 The ZMK Contributors
# SPDX-License-Identifier: MIT

config SHIELD_TJOCKBOARD_LEFT
	def_bool $(shields_list_contains,tjockboard_left)

config SHIELD_TJOCKBOARD_RIGHT
	def_bool $(shields_list_contains,tjockboard_right)
```

## config/boards/shields/lajjBoard/Kconfig.defconfig
```kconfig
# Copyright (c) 2022 The ZMK Contributors
# SPDX-License-Identifier: MIT

if SHIELD_LAJJBOARD_LEFT

config ZMK_KEYBOARD_NAME
	default "lajjBoard"

config ZMK_SPLIT_BLE_ROLE_CENTRAL
	default y

endif

if SHIELD_LAJJBOARD_LEFT || SHIELD_LAJJBOARD_RIGHT

config ZMK_SPLIT
	default y
endif
```

## config/boards/shields/lajjBoard/Kconfig.shield
```kconfig
# Copyright (c) 2022 The ZMK Contributors
# SPDX-License-Identifier: MIT

config SHIELD_LAJJBOARD_LEFT
	def_bool $(shields_list_contains,lajjboard_left)

config SHIELD_LAJJBOARD_RIGHT
	def_bool $(shields_list_contains,lajjboard_right)
```

## config/boards/shields/rae_dux_no_splay/Kconfig.defconfig
```kconfig
# Copyright (c) 2022 The ZMK Contributors
# SPDX-License-Identifier: MIT

if SHIELD_RAE_DUX_NO_SPLAY_LEFT

config ZMK_KEYBOARD_NAME
	default "rae-dux_no_splay"

config ZMK_SPLIT_BLE_ROLE_CENTRAL
	default y

endif

if SHIELD_RAE_DUX_NO_SPLAY_LEFT || SHIELD_RAE_DUX_NO_SPLAY_RIGHT

config ZMK_SPLIT
	default y
endif
```

## config/boards/shields/rae_dux_no_splay/Kconfig.shield
```kconfig
# Copyright (c) 2022 The ZMK Contributors
# SPDX-License-Identifier: MIT

config SHIELD_RAE_NO_SPLAY_DUX_LEFT
	def_bool $(shields_list_contains,rae_dux_no_splay_left)

config SHIELD_RAE_DUX_NO_SPLAY_RIGHT
	def_bool $(shields_list_contains,rae_dux_no_splay_right)
```
